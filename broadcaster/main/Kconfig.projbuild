## broadcaster/main/Kconfig.projbuild
```kconfig
menu "CSI Broadcaster Configuration"

    config WIFI_SSID
        string "WiFi SSID"
        default "myssid"
        help
            SSID (network name) to connect to.

    config WIFI_PASSWORD
        string "WiFi Password"
        default "mypassword"
        help
            WiFi password (WPA or WPA2).

    config OTA_SERVER_URL
        string "OTA Server URL"
        default "http://192.168.1.100:8070"
        help
            Base URL of the OTA server (e.g., http://192.168.1.100:8070).
            The device will fetch /version/broadcaster and /firmware/broadcaster.

    config LED_GPIO
        int "Status LED GPIO"
        default 2
        range 0 34
        help
            GPIO number for the status LED.

endmenu
```

## broadcaster/sdkconfig.defaults
```kconfig
# ESP-WROOM-32 Broadcaster Configuration

# Target
CONFIG_IDF_TARGET="esp32"

# Flash size
CONFIG_ESPTOOLPY_FLASHSIZE_4MB=y

# Partition table
CONFIG_PARTITION_TABLE_CUSTOM=y
CONFIG_PARTITION_TABLE_CUSTOM_FILENAME="partitions.csv"
CONFIG_PARTITION_TABLE_FILENAME="partitions.csv"

# FreeRTOS
CONFIG_FREERTOS_HZ=1000

# OTA
CONFIG_BOOTLOADER_APP_ROLLBACK_ENABLE=y

# Main task
CONFIG_ESP_MAIN_TASK_STACK_SIZE=4096

# Disable SoftAP support (not needed)
CONFIG_ESP_WIFI_SOFTAP_SUPPORT=n

# Log level
CONFIG_LOG_DEFAULT_LEVEL_INFO=y
```

## receiver/main/Kconfig.projbuild
```kconfig
menu "CSI Receiver Configuration"

    config WIFI_SSID
        string "WiFi SSID"
        default "myssid"
        help
            SSID (network name) to connect to.

    config WIFI_PASSWORD
        string "WiFi Password"
        default "mypassword"
        help
            WiFi password (WPA or WPA2).

    config OTA_SERVER_URL
        string "OTA Server URL"
        default "http://192.168.1.100:8070"
        help
            Base URL of the OTA server (e.g., http://192.168.1.100:8070).
            The device will fetch /version/receiver and /firmware/receiver.

    config LED_GPIO
        int "Status LED GPIO"
        default 2
        range 0 48
        help
            GPIO number for the status LED.

    config DEFAULT_CHANNEL
        int "Default CSI Channel"
        default 6
        range 1 13
        help
            Default WiFi channel for CSI collection (1-13).

    config MDNS_HOSTNAME
        string "mDNS Hostname"
        default "espcsi"
        help
            mDNS hostname (access via http://<hostname>.local).

endmenu
```

## receiver/sdkconfig.defaults
```kconfig
# ESP32-S3 Receiver Configuration

# Target
CONFIG_IDF_TARGET="esp32s3"

# Flash size
CONFIG_ESPTOOLPY_FLASHSIZE_16MB=y

# Partition table
CONFIG_PARTITION_TABLE_CUSTOM=y
CONFIG_PARTITION_TABLE_CUSTOM_FILENAME="partitions.csv"
CONFIG_PARTITION_TABLE_FILENAME="partitions.csv"

# WiFi CSI
CONFIG_ESP_WIFI_CSI_ENABLED=y

# FreeRTOS
CONFIG_FREERTOS_HZ=1000

# HTTP Server
CONFIG_HTTPD_MAX_REQ_HDR_LEN=1024
CONFIG_HTTPD_MAX_URI_LEN=1024

# FATFS
CONFIG_FATFS_LONG_FILENAMES=y
CONFIG_FATFS_LFN_HEAP=y

# OTA
CONFIG_BOOTLOADER_APP_ROLLBACK_ENABLE=y

# SNTP
CONFIG_LWIP_SNTP_MAX_SERVERS=3

# Main task
CONFIG_ESP_MAIN_TASK_STACK_SIZE=6144

# WiFi buffers
CONFIG_ESP_WIFI_STATIC_RX_BUFFER_NUM=16
CONFIG_ESP_WIFI_DYNAMIC_RX_BUFFER_NUM=64

# Log level
CONFIG_LOG_DEFAULT_LEVEL_INFO=y
```
